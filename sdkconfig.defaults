## sdkconfig.defaults
```kconfig
# 总开关蓝牙
CONFIG_BT_ENABLED=y
CONFIG_BT_BLUEDROID_ENABLED=y

# 启用经典蓝牙BR/EDR
CONFIG_BT_CLASSIC_ENABLED=y
CONFIG_BTDM_CONTROLLER_MODE_BTDM=y

# 开启SPP串口透传（最常用）
CONFIG_BT_SPP_ENABLED=y
CONFIG_BT_SPP_BUFFER_TX_NUM=12
CONFIG_BT_SPP_BUFFER_RX_NUM=12

# 蓝牙内存缓冲优化（CI编译不爆内存）
CONFIG_BT_BLUEDROID_MEM_DEBUG=n
CONFIG_BT_ACL_TX_BUF_NUM=16
CONFIG_BT_ACL_RX_BUF_NUM=16

# 关闭不用音频节省内存（需要A2DP/HFP再打开）
CONFIG_BT_A2DP_ENABLE=n
CONFIG_BT_HFP_ENABLE=n

# 控制器缓冲优化
CONFIG_BTDM_CTRL_BLE_TX_BUFFER_NUM=10
CONFIG_BTDM_CTRL_BR_EDR_TX_BUFFER_NUM=10

# 模块芯片目标esp32（WROOM-UE）
CONFIG_IDF_TARGET_ESP32=y
CONFIG_IDF_TARGET="esp32"

# 日志等级按需调整
CONFIG_LOG_DEFAULT_LEVEL_INFO=y
```
